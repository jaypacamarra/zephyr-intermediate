## CMakeLists.txt
```
cmake_minimum_required(VERSION 3.20.0)

find_package(Zephyr REQUIRED HINTS $ENV{ZEPHYR_BASE})
project(l4-task1)

target_sources(app PRIVATE
        src/main.c
        src/sensor.c
        src/logger.c
        src/display.c
)

target_include_directories(app PRIVATE include)
```

## prj.conf
```kconfig
CONFIG_LOG=y
CONFIG_THREAD_NAME=y
CONFIG_ZBUS=y
CONFIG_ZBUS_OBSERVER_NAME=y
```

## src/main.c
```c
#include <zephyr/kernel.h>
#include <zephyr/logging/log.h>
#include <zephyr/zbus/zbus.h>
#include <sensor_iface.h>

LOG_MODULE_REGISTER(main_thread, LOG_LEVEL_DBG);

ZBUS_CHAN_DEFINE(sensor_chan, struct sensor_data, NULL, NULL,
                ZBUS_OBSERVERS(display_lis, logger_sub),
                ZBUS_MSG_INIT(.encoder_pos = 0))

int main(void)
{
    LOG_INF("=== L4 Homework: Event Driven Zbus System With Simulated Sensor Data ===");

    return 0;
}
```

## src/logger.c
```c
#include <zephyr/kernel.h>
#include <zephyr/logging/log.h>
#include <zephyr/zbus/zbus.h>
#include <sensor_iface.h>

LOG_MODULE_REGISTER(logger);
ZBUS_SUBSCRIBER_DEFINE(logger_sub, 4);

void logger_thread_fn(void *a, void *b, void *c)
{
        int ret;
        const struct zbus_channel *chan;
        struct sensor_data msg = {0};
        
        while (1) {
                ret = zbus_sub_wait(&logger_sub, &chan, K_FOREVER);
                if (ret < 0) {
                        continue;
                }

                zbus_chan_read(chan, &msg, K_MSEC(100));
                LOG_INF("Encoder data: %d", msg.encoder_pos);
                k_sleep(K_MSEC(1000));
        }
}

K_THREAD_DEFINE(logger_thread, 1024, logger_thread_fn, NULL, NULL, NULL, 5, 0, 0);
```

## src/sensor.c
```c
#include <zephyr/kernel.h>
#include <zephyr/logging/log.h>
#include <zephyr/zbus/zbus.h>
#include <sensor_iface.h>

LOG_MODULE_REGISTER(sensor_sim);

/**
 * @brief Sensor simulator thread.
 */
void sensor_sim_fn(void *a, void *b, void *c)
{
        struct sensor_data data = {0};

        while (1) {
                data.encoder_pos += 10;
                data.timestamp_ms = k_uptime_get();

                (void)zbus_chan_pub(&sensor_chan, &data, K_MSEC(100)); 
                LOG_INF("sensor sim published data");

                k_sleep(K_MSEC(100));

        }
}

K_THREAD_DEFINE(sensor_thread,  1024, sensor_sim_fn, NULL, NULL, NULL, 2, 0, 0);
```
