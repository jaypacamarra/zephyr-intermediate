## CMakeLists.txt
```
cmake_minimum_required(VERSION 3.20.0)

find_package(Zephyr REQUIRED HINTS $ENV{ZEPHYR_BASE})
project(l5-task1)

target_sources(app PRIVATE
        src/main.c
        src/sensor.c
        src/logger.c
        src/display.c
)

target_include_directories(app PRIVATE include)
```

## prj.conf
```kconfig
CONFIG_LOG=y
CONFIG_THREAD_NAME=y
CONFIG_ZBUS=y
CONFIG_ZBUS_OBSERVER_NAME=y

CONFIG_THREAD_ANALYZER=y

CONFIG_WATCHDOG=y
CONFIG_TASK_WDT=y
CONFIG_TASK_WDT_HW_FALLBACK=y

CONFIG_HWINFO=y
```

## src/main.c
```c
#include <zephyr/kernel.h>
#include <zephyr/logging/log.h>
#include <zephyr/zbus/zbus.h>
#include <zephyr/debug/thread_analyzer.h>
#include <zephyr/drivers/hwinfo.h>
#include <sensor_iface.h>

LOG_MODULE_REGISTER(main_thread, LOG_LEVEL_DBG);

ZBUS_CHAN_DEFINE(sensor_chan, struct sensor_data, NULL, NULL,
                ZBUS_OBSERVERS(display_lis, logger_sub),
                ZBUS_MSG_INIT(.encoder_pos = 0))

void print_reset_cause(uint32_t cause)
{
        LOG_INF("raw cause %u", cause);

        if (cause & RESET_PIN)
                LOG_INF("reset cause: external pin");
        if (cause & RESET_SOFTWARE)
                LOG_INF("reset cause: software reset");
        if (cause & RESET_BROWNOUT)
                LOG_INF("reset cause: brownout");
        if (cause & RESET_POR)
                LOG_INF("reset cause: power-on reset");
        if (cause & RESET_WATCHDOG)
                LOG_INF("reset cause: watchdog");
        if (cause & RESET_DEBUG)
                LOG_INF("reset cause: debug event");
        if (cause & RESET_SECURITY)
                LOG_INF("reset cause: security violations");
        if (cause & RESET_LOW_POWER_WAKE)
                LOG_INF("reset cause: waking up from low power mode");
        if (cause & RESET_CPU_LOCKUP)
                LOG_INF("reset cause: CPU lock-up detected");
        if (cause & RESET_PARITY)
                LOG_INF("reset cause: parity error");
        if (cause & RESET_PLL)
                LOG_INF("reset cause: PLL error");
        if (cause & RESET_CLOCK)
                LOG_INF("reset cause: Clock error");
        if (cause & RESET_HARDWARE)
                LOG_INF("reset cause: Hardware reset");
        if (cause & RESET_USER)
                LOG_INF("reset cause: User reset");
        if (cause & RESET_TEMPERATURE)
                LOG_INF("reset cause: Temperature reset");
        if (cause & RESET_BOOTLOADER)
                LOG_INF("reset cause: Bootloader reset (entry/exit)");
        if (cause & RESET_FLASH)
                LOG_INF("reset cause: Flash ECC reset");

        (void)hwinfo_clear_reset_cause();
}

int main(void)
{
        LOG_INF("=== L4 Homework: Event Driven Zbus System With Simulated Sensor Data ===");

        uint32_t cause;
        hwinfo_get_reset_cause(&cause);
        print_reset_cause(cause);

        while (1) {
                //thread_analyzer_print(0);
                k_sleep(K_MSEC(1000));
        }

        return 0;
}
```

## include/sensor_iface.h
```c
#ifndef INCLUDE_SENSOR_IFACE_H
#define INCLUDE_SENSOR_IFACE_H

#include <stdint.h>
#include <zephyr/zbus/zbus.h>

struct sensor_data {
        uint32_t timestamp_ms;
        int32_t encoder_pos;
};

ZBUS_CHAN_DECLARE(sensor_chan);

#endif /* INCLUDE_SENSOR_IFACE_H */
```

## src/display.c
```c
#include <zephyr/kernel.h>
#include <zephyr/logging/log.h>
#include <zephyr/zbus/zbus.h>
#include <sensor_iface.h>

LOG_MODULE_REGISTER(display);

void display_callback(const struct zbus_channel *chan)
{
        const struct sensor_data *data = zbus_chan_const_msg(chan);

        LOG_INF("Encoder data: %d", data->encoder_pos);
}

ZBUS_LISTENER_DEFINE(display_lis, display_callback);
```

## src/logger.c
```c
#include <zephyr/kernel.h>
#include <zephyr/logging/log.h>
#include <zephyr/zbus/zbus.h>
#include <zephyr/task_wdt/task_wdt.h>
#include <sensor_iface.h>

#define QUEUE_DEPTH 32

LOG_MODULE_REGISTER(logger);
ZBUS_SUBSCRIBER_DEFINE(logger_sub, 32);

const struct device *wdg = DEVICE_DT_GET(DT_ALIAS(watchdog0));

void wdt_expired(int channel_id, void *user_data)
{
        ARG_UNUSED(channel_id);
        ARG_UNUSED(user_data);
}

void health_check_thread_fn(void *a, void *b, void *c)
{
        LOG_INF("health check thread started");
        while (1) {
                uint32_t used = k_msgq_num_used_get(logger_sub.queue);
                LOG_INF("used = %d", used);
                if (used > (QUEUE_DEPTH * 3 / 4)) {
                        LOG_WRN("Queue at %d/%d", used, QUEUE_DEPTH);
                }

                k_sleep(K_MSEC(50));
        }
}

void logger_thread_fn(void *a, void *b, void *c)
{
        int ret;
        const struct zbus_channel *chan;
        struct sensor_data msg = {0};

        if (!device_is_ready(wdg)) {
                LOG_ERR("%s not ready", wdg->name);
                return;
        }
        
        ret = task_wdt_init(wdg);
        if (ret < 0) {
                LOG_ERR("task watchdog failed to initialize");
                return;
        }

        int wdt_chan = task_wdt_add(2000, wdt_expired, (void *)k_current_get());
        if (wdt_chan < 0) {
                LOG_ERR("task watchdog failed to regster channel");
                return;
        }

        while (1) {
                ret = zbus_sub_wait(&logger_sub, &chan, K_FOREVER);
                if (ret < 0) {
                        continue;
                }

                zbus_chan_read(chan, &msg, K_MSEC(100));
                LOG_INF("Encoder data: %d", msg.encoder_pos);

                /* here we simulate a stuck consumer at the 20 second mark */
                if (k_uptime_seconds() <= 20) {
                        task_wdt_feed(wdt_chan);
                }

                k_sleep(K_MSEC(1000));
        }
}

K_THREAD_DEFINE(logger_thread, 1024, logger_thread_fn, NULL, NULL, NULL, 5, 0, 0);
K_THREAD_DEFINE(health_check_thread, 1024, health_check_thread_fn, NULL, NULL, NULL, 6, 0, 0);
```
